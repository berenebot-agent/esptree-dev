## device_code/native_serial_bridge/main/Kconfig.projbuild
```kconfig
menu "ESP Tree Native Serial Bridge (experimental)"

    config ESP_TREE_NETWORK_ID
        string "ESP-NOW network ID (must match remotes)"
        default ""

    config ESP_TREE_PSK
        string "ESP-NOW 64-character hexadecimal PSK"
        default ""

    config ESP_TREE_API_KEY
        string "Serial protobuf API HMAC key (must match add-on)"
        default ""

    config ESP_TREE_NODE_NAME
        string "Bridge device name"
        default "esp-tree-native-serial"

    choice ESP_TREE_RADIO_MODE
        prompt "ESP-NOW PHY mode"
        default ESP_TREE_RADIO_REGULAR

        config ESP_TREE_RADIO_REGULAR
            bool "Regular (required for ESP8266 leaves)"

        config ESP_TREE_RADIO_LR
            bool "Long Range (supported ESP32 radios/leaves only)"
    endchoice

    config ESP_TREE_RADIO_CHANNEL
        int "Fixed 2.4 GHz radio channel"
        range 1 13
        default 11
        help
            Must match fixed-channel leaves and ESP8266 AP channel.
            No access point association is performed.

    config ESP_TREE_UART_PORT
        int "Hardware UART controller (0, 1, or 2 on chips that provide it)"
        range 0 2
        default 0
        help
            Not USB-CDC or USB-Serial-JTAG; uses an external UART adapter.
            The application verifies this index against the selected chip.

    config ESP_TREE_UART_TX_GPIO
        int "Hardware UART TX GPIO (chip UART0 default; override for board)"
        range 0 48
        default 1 if IDF_TARGET_ESP32
        default 43 if IDF_TARGET_ESP32S2 || IDF_TARGET_ESP32S3
        default 20 if IDF_TARGET_ESP32C2
        default 21 if IDF_TARGET_ESP32C3
        default 11 if IDF_TARGET_ESP32C5
        default 16 if IDF_TARGET_ESP32C6
        help
            UART0 defaults follow the repository's BOARD_MATRIX.md.
            Individual boards may have different header connections.
            Every supported target has a default; a target added without one
            falls back to 0 and is rejected by the build (TX == RX).

    config ESP_TREE_UART_RX_GPIO
        int "Hardware UART RX GPIO (chip UART0 default; override for board)"
        range 0 48
        default 3 if IDF_TARGET_ESP32
        default 44 if IDF_TARGET_ESP32S2 || IDF_TARGET_ESP32S3
        default 19 if IDF_TARGET_ESP32C2
        default 20 if IDF_TARGET_ESP32C3
        default 12 if IDF_TARGET_ESP32C5
        default 17 if IDF_TARGET_ESP32C6
        help
            Requires a valid input-capable pin on the selected board.
            Every supported target has a default; a target added without one
            falls back to 0 and is rejected by the build (TX == RX).

    config ESP_TREE_UART_BAUD
        int "Hardware UART baud rate"
        range 9600 3000000
        default 460800

    config ESP_TREE_REMOTE_OTA
        bool "Enable OTA of ESP-NOW remote nodes"
        default y

endmenu
```
